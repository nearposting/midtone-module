## boards/shields/bbb/Kconfig.defconfig
```kconfig
if SHIELD_BBB

# Name must be less than 16 characters long!
config ZMK_KEYBOARD_NAME
    default "bbb"

endif
```

## boards/shields/midtone/Kconfig.defconfig
```kconfig
if SHIELD_TWOTEST

# Name must be less than 16 characters long!
config ZMK_TWOTEST
    default "twotest"

endif
```
